## drivers/input/touchscreen/xiaomi/Kconfig
```kconfig
source "drivers/input/touchscreen/xiaomi/nt36672c/Kconfig"
source "drivers/input/touchscreen/xiaomi/fts_521/Kconfig"
source "drivers/input/touchscreen/xiaomi/goodix_driver_gt9886/Kconfig"

config I2C_BY_DMA
	bool "I2C BY DMA"

config SECURE_TOUCH
	bool "Secure Touch"
```
